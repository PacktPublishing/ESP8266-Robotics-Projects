
#include <ESP8266_Lib.h>
#include <BlynkSimpleShieldEsp8266.h>
#include <SparkFun_TB6612.h>

char auth[] = "53e4da8793764b6197fc44a673ce4e21";

char ssid[] = "YourNetworkName";
char pass[] = "YourPassword";

#include <SoftwareSerial.h>
SoftwareSerial EspSerial(2, 3); // RX, TX

#define ESP8266_BAUD 115200

ESP8266 wifi(&EspSerial);

#define AIN1 12
#define BIN1 7
#define AIN2 4
#define BIN2 8
#define PWMA 5
#define PWMB 6
#define STBY 9

const int offsetA = 1;
const int offsetB = 1;

Motor motor1 = Motor(AIN1, AIN2, PWMA, offsetA, STBY);
Motor motor2 = Motor(BIN1, BIN2, PWMB, offsetB, STBY);

/*
   Variable declaration section for encoders
*/
unsigned long time;

volatile int lCount = 0; // ticks counter for left encoder
volatile int rCount = 0; // ticks counter for right encoder
/*

*/

/*
  Send calculated distance traveled and average speed values to Blynk Virtual Pins
*/

BlynkTimer timer;

void myTimerEvent()
{
  float averagePulseCount = (lCount + rCount) / 2;

  //Calculate and display distance traveled
  float wheelDiameter = 65;
  float wheelCircumference = wheelDiameter * PI;
  float distanceTraveled = ((wheelCircumference / 8) * averagePulseCount) / 25.4;
  Blynk.virtualWrite(V2, distanceTraveled);


  //Calculate and display average speed
  time = millis(); // Counting time science the robot started
  float minutes = (time / 1000) / 60; //Converts milliseconds to minutes
  float averageSpeed = distanceTraveled / minutes;
  Blynk.virtualWrite(V3, averageSpeed);

}
/*

*/

// This function will be called every time Slider Widget
// in Blynk app writes values to the Virtual Pin V1
BLYNK_WRITE(V1)
{
  int x = param[0].asInt(); // assigning incoming value from pin V1 to a variable
  int y = param[1].asInt(); // assigning incoming value from pin V1 to a variable


  if (y > 220)

    forward(motor1, motor2, 150);

  else if (y < 35)

    back(motor1, motor2, -150);

  else if (x > 220)

    right(motor1, motor2, 150);

  else if (x < 35)

    left(motor1, motor2, 150);

  else
    brake(motor1, motor2);

}

void setup()
{
  // Debug console
  Serial.begin(9600);

  // Set ESP8266 baud rate
  EspSerial.begin(ESP8266_BAUD);
  delay(10);

  Blynk.begin(auth, wifi, ssid, pass);

  /*
    Attach interrupts to Arduino digital pins
  */

  // Setup the myTimerEvent() function to be called every second
  timer.setInterval(1000L, myTimerEvent);

  // Configure digital pin 2 and 3 as input and inverts the behavior of the INPUT mode, where HIGH means the sensor is off, and LOW means the sensor is on
  pinMode(2, INPUT_PULLUP);
  pinMode(3, INPUT_PULLUP);
  // Attach interrupts
  attachInterrupt(digitalPinToInterrupt(2), leftMotorEncoderCallback, CHANGE); // Attach left wheel encoder to the Arduino digital pin 2 for trigger a function using interrupts
  attachInterrupt(digitalPinToInterrupt(3), rightMotorEncoderCallback, CHANGE); // Attach right wheel encoder to the Arduino digital pin 3 for trigger a function using interrupts

  /*

  */
}


void loop()
{
  Blynk.run();
}
/*
   Callback functions for counting signal (pulses) generated by the left and right wheel encoders
*/

void leftMotorEncoderCallback()
{
  lCount++;
}

void rightMotorEncoderCallback()
{
  rCount++;
}
/*

*/

